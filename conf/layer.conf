## conf/layer.conf
```bitbake
# We have a conf and classes directory, add to BBPATH
BBPATH .= ":${LAYERDIR}"

# We have recipes-* directories, add to BBFILES
BBFILES += "${LAYERDIR}/recipes-*/*/*.bb \
	${LAYERDIR}/recipes-*/*/*.bbappend"

BBFILE_COLLECTIONS += "imx6-overlays"
BBFILE_PATTERN_imx6-overlays = "^${LAYERDIR}/"
BBFILE_PRIORITY_imx6-overlays = "10"

META_IMX6_OVERLAYS = "${LAYERDIR}"
```
